/dts-v1/;
/plugin/;

/*
 * 释放40针排针12脚GPIO0_B5，供程序申请普通GPIO输入或输出。
 * 此脚原来可用于PWM1_CH1_M0，这里只停用该PWM通道。
 * UART3的收发脚和18脚急诊指示灯不在本配置的修改范围内。
 * 程序需自行申请GPIO0的13号线并设置方向；不设置固定占用，
 * 不自动切换485收发，不改变串口参数，也不发送任何数据。
 */
&pwm1_6ch_1 {
    status = "disabled";
};
